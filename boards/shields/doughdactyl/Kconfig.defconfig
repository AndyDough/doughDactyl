## boards/shields/doughdactyl/Kconfig.defconfig
```kconfig
if SHIELD_doughdactyl_LEFT

config ZMK_KEYBOARD_NAME
    default "doughDactyl"

config ZMK_SPLIT_ROLE_CENTRAL
    default y

endif # SHIELD_doughdactyl_LEFT

if SHIELD_doughdactyl_LEFT || SHIELD_doughdactyl_RIGHT

config ZMK_SPLIT
    default y

endif # SHIELD_doughdactyl_LEFT || SHIELD_doughdactyl_RIGHT
```

## boards/shields/doughdactyl/Kconfig.shield
```kconfig
config SHIELD_doughdactyl_LEFT
    def_bool $(shields_list_contains,doughdactyl_left)

config SHIELD_doughdactyl_RIGHT
    def_bool $(shields_list_contains,doughdactyl_right)
```
